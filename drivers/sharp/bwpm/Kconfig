## drivers/sharp/bwpm/Kconfig
```kconfig
# drivers/sharp/wifi/Kconfig

menu "Wi-Fi Configuration"

config BWPM
	bool "BT/WLAN Power Management Support"
	default y
	help
	  Power management implementation for BT, FM, and WLAN Functionality.

endmenu
```

## drivers/sharp/proximity/Kconfig
```kconfig
#
# Proximity device configuration
#
# drivers/sharp/proximity/Kconfig

menu "Proximity Configuration"

config SENSORS_PROXIMITY
	tristate "Proximity Sensor Driver"
	depends on I2C

endmenu
```

## drivers/sharp/shirpm/Kconfig
```kconfig
menu "SHARP Infrared drivers"

config SHIRDA
	bool "SHARP LR388G7 IrDA SIR/FIR driver"
	default y
	select SHIRPM

config SHIRRC
	bool "SHARP LR388G7 IrRemoteControl driver"
	default y
	select SHIRPM

config SHIRPM
	depends on SHIRDA || SHIRRC
	bool "Infrared Power Management Support"
	default y

endmenu
```

## drivers/sharp/shmds/ami603/Kconfig
```kconfig
menu "AMI603 MDS DRIVER"

config SENSORS_AMI603
	tristate "AMI603 sensor"

config SENSORS_AMI603_DATA
	tristate "AMI603 DATA"

endmenu
```

## drivers/sharp/shtps/Kconfig
```kconfig
#
# Sharp Touchscreen configuration
#

config TOUCHSCREEN_SHTPS
	tristate "Synaptics RMI4 based touchscreens"
	default y
	depends on SPI_MASTER

if TOUCHSCREEN_SHTPS

	config SHTPS_TMA3XX_TMA340_002
		tristate "TMA3XX TMA340-002"
		default n
		depends on TOUCHSCREEN_SHTPS

endif # TOUCHSCREEN_SHTPS
```

## drivers/sharp/wifi/Kconfig
```kconfig
# drivers/sharp/wifi/Kconfig

menu "Wi-Fi Configuration"

config CSR_SYNERGY_WIFI
	bool "CSR Synergy Wifi Support"
	default y
	help
	  Enable CSR WiFi device driver.

endmenu
```
